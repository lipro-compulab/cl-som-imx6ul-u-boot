## board/compulab/cl_som_imx6ul/Kconfig
```kconfig
if TARGET_CL_SOM_IMX6UL

config SYS_BOARD
	default "cl_som_imx6ul"

config SYS_VENDOR
	default "compulab"

config SYS_CONFIG_NAME
	default "cl_som_imx6ul"

endif
```
